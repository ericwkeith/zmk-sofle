## config/west.yml
```yaml
manifest:
  remotes:
    - name: zmkfirmware
      url-base: https://github.com/zmkfirmware

  projects:
    - name: zmk
      remote: zmkfirmware
      revision: v0.3      # pinned to pre-Zephyr-4.1 ZMK
      import: app/west.yml

  self:
    path: config
```
